## conf/machine/cubieboard2.conf
```bitbake
#@TYPE: Machine
#@NAME: CubieBoard
#@DESCRIPTION: Machine configuration for the cubieboard2, based on allwinner a20 CPU http://cubieboard.org/

PREFERRED_PROVIDER_virtual/xserver = "xserver-xorg"
XSERVER = "xserver-xorg \
           xf86-input-evdev \
           xf86-input-mouse \
           xf86-input-keyboard"

# Only has DVI connector for external screen
GUI_MACHINE_CLASS = "bigscreen"

require conf/machine/include/tune-cortexa7.inc

PREFERRED_PROVIDER_virtual/kernel = "linux-sunxi"
PREFERRED_VERSION_linux-sunxi_cubieboard = "3.4.61-git"
PREFERRED_VERSION_linux-libc-headers = "3.4"

KERNEL_IMAGETYPE = "uImage"

UBOOT_MACHINE = "cubieboard2"
UBOOT_ENTRYPOINT = "0x40008000"
UBOOT_LOADADDRESS = "0x40008000"

UBOOT_BINARY = "u-boot-sunxi-with-spl.${UBOOT_SUFFIX}"
UBOOT_SYMLINK = "u-boot-sunxi-with-spl-${MACHINE}.${UBOOT_SUFFIX}"

IMAGE_CLASSES += "sdcard_image-a10"
IMAGE_FSTYPES += "ext3 tar.gz a10-sdimg"


# Guesswork
SERIAL_CONSOLE = "115200 ttyS0"

MACHINE_EXTRA_RRECOMMENDS = "\
 kernel-module-sw-ahci-platform \
"

MACHINE_FEATURES = "kernel26 screen apm usbgadget usbhost vfat alsa"
```

## conf/machine/olinuxino-a13.conf
```bitbake
#@TYPE: Machine
#@NAME: Olimex A13-OLinuXino Board
#@DESCRIPTION: Machine configuration for the Olime A13-OLinuXino Board, base on allwinner a13 CPU
#https://github.com/OLIMEX/OLINUXINO

PREFERRED_PROVIDER_virtual/xserver = "xserver-xorg"
XSERVER = "xserver-xorg \
	   xf86-input-tslib \
	   tslib-calibrate \
	   tslib-tests \
           xf86-input-evdev \
           xf86-input-mouse \
           xf86-input-keyboard \
	   xf86-video-fbdev \
"

# Only has DVI connector for external screen
GUI_MACHINE_CLASS = "bigscreen"

require conf/machine/include/tune-cortexa8.inc

PREFERRED_PROVIDER_virtual/kernel = "linux-sunxi"
PREFERRED_VERSION_linux-sunxi_olinuxino-a13 = "3.4.61-git"
PREFERRED_VERSION_linux-libc-headers = "3.4"

KERNEL_IMAGETYPE = "uImage"

UBOOT_MACHINE = "a13_olinuxino"
UBOOT_ENTRYPOINT = "0x40008000"
UBOOT_LOADADDRESS = "0x40008000"

UBOOT_BINARY = "u-boot-sunxi-with-spl.${UBOOT_SUFFIX}"
UBOOT_SYMLINK = "u-boot-sunxi-with-spl-${MACHINE}.${UBOOT_SUFFIX}"

IMAGE_FSTYPES += "tar.bz2 squashfs a10-sdimg"

# Guesswork
SERIAL_CONSOLE = "115200 ttyS0"

MACHINE_FEATURES = "kernel26 screen apm usbgadget usbhost vfat alsa"
```

## conf/machine/olinuxino-a20.conf
```bitbake
#@TYPE: Machine
#@NAME: Olimex A20-OLinuXino Board
#@DESCRIPTION: Machine configuration for the Olime A20-OLinuXino Board, base on allwinner a20 CPU
#https://github.com/OLIMEX/OLINUXINO

PREFERRED_PROVIDER_virtual/xserver = "xserver-xorg"
XSERVER = "xserver-xorg \
	   xf86-input-tslib \
	   tslib-calibrate \
	   tslib-tests \
           xf86-input-evdev \
           xf86-input-mouse \
           xf86-input-keyboard \
	   xf86-video-fbdev \
"

# Only has DVI connector for external screen
GUI_MACHINE_CLASS = "bigscreen"

require conf/machine/include/tune-cortexa7.inc

PREFERRED_PROVIDER_virtual/kernel = "linux-sunxi"
PREFERRED_VERSION_linux-sunxi_olinuxino-a20 = "3.4.61-git"
PREFERRED_VERSION_linux-libc-headers = "3.4"

KERNEL_IMAGETYPE = "uImage"

UBOOT_MACHINE = "a20-olinuxino_micro"
UBOOT_ENTRYPOINT = "0x40008000"
UBOOT_LOADADDRESS = "0x40008000"
UBOOT_BINARY = "u-boot-sunxi-with-spl.${UBOOT_SUFFIX}"
UBOOT_SYMLINK = "u-boot-sunxi-with-spl-${MACHINE}.${UBOOT_SUFFIX}"

IMAGE_CLASSES += "sdcard_image-a10"
IMAGE_FSTYPES += "tar.bz2 ext3 a10-sdimg"

# Guesswork
SERIAL_CONSOLE = "115200 ttyS0"

MACHINE_FEATURES = "kernel26 screen apm usbgadget usbhost vfat alsa"

MACHINE_EXTRA_RRECOMMENDS = "\
 kernel-modules \
"
```
